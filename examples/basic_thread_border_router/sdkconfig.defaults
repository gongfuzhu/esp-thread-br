## examples/basic_thread_border_router/sdkconfig.defaults
```kconfig
# ESP32-C6 host + external ESP32-H2 RCP (UART), adapted for C6+H2 / 4MB flash
CONFIG_IDF_TARGET="esp32c6"

#
# Serial flasher config
#
CONFIG_ESPTOOLPY_FLASHSIZE_4MB=y
# end of Serial flasher config

#
# Partition Table
#
CONFIG_PARTITION_TABLE_CUSTOM=y
CONFIG_PARTITION_TABLE_CUSTOM_FILENAME="partitions.csv"
CONFIG_PARTITION_TABLE_FILENAME="partitions.csv"
CONFIG_PARTITION_TABLE_OFFSET=0x8000
CONFIG_PARTITION_TABLE_MD5=y
# end of Partition Table

#
# Compiler options
#
CONFIG_COMPILER_OPTIMIZATION_SIZE=y

#
# Newlib
#
CONFIG_NEWLIB_NANO_FORMAT=y

#
# mbedTLS
#

CONFIG_MBEDTLS_CMAC_C=y
CONFIG_MBEDTLS_SSL_PROTO_DTLS=y
CONFIG_MBEDTLS_KEY_EXCHANGE_ECJPAKE=y
# end of TLS Key Exchange Methods

CONFIG_MBEDTLS_ECJPAKE_C=y
# end of mbedTLS

#
# OpenThread
#
CONFIG_OPENTHREAD_ENABLED=y
CONFIG_OPENTHREAD_BORDER_ROUTER=y
CONFIG_OPENTHREAD_CLI_OTA=y
CONFIG_OPENTHREAD_RCP_COMMAND=y
CONFIG_OPENTHREAD_RADIO_SPINEL_UART=y
CONFIG_OPENTHREAD_TASK_SIZE=8192
# end of OpenThread

#
# OpenThread Border Router Example
#
# No RESET/BOOT wired to H2 (only TX=4/RX=5/GND) -> host cannot auto-flash/reset RCP.
# H2 must be flashed with ot_rcp manually; disable auto update.
# CONFIG_AUTO_UPDATE_RCP is not set
# end of OpenThread Border Router Example

#
# lwIP
#
CONFIG_LWIP_IPV6_FORWARD=y

# Use 12 with IDF v5.3.1 and later, and use 8 with earlier versions of IDF.
CONFIG_LWIP_IPV6_NUM_ADDRESSES=12

CONFIG_LWIP_MULTICAST_PING=y
CONFIG_LWIP_NETIF_STATUS_CALLBACK=y
CONFIG_LWIP_HOOK_IP6_ROUTE_DEFAULT=y
CONFIG_LWIP_HOOK_ND6_GET_GW_DEFAULT=y
CONFIG_LWIP_HOOK_IP6_INPUT_CUSTOM=y
CONFIG_LWIP_IPV6_AUTOCONFIG=y
CONFIG_LWIP_HOOK_IP6_SELECT_SRC_ADDR_CUSTOM=y
CONFIG_LWIP_FORCE_ROUTER_FORWARDING=y
# end of lwIP

#
# mDNS
#
CONFIG_MDNS_MULTIPLE_INSTANCE=y
CONFIG_MDNS_MAX_SERVICES=200
# end of mDNS

#
# ESP System Settings
#
CONFIG_ESP_SYSTEM_EVENT_TASK_STACK_SIZE=3584
CONFIG_ESP_MAIN_TASK_STACK_SIZE=5120
# end of ESP System Settings

#
# ESP Thread Border Router board / RCP wiring
#
# Standalone dev kit: manually wired RCP over UART
CONFIG_ESP_BR_BOARD_STANDALONE=y
# RCP target is ESP32-H2
CONFIG_ESP_BR_H2_TARGET=y
# UART pins to H2 RCP (host TX=GPIO4 -> H2 RX, host RX=GPIO5 -> H2 TX)
CONFIG_PIN_TO_RCP_TX=4
CONFIG_PIN_TO_RCP_RX=5
# Console over onboard USB Serial/JTAG (Type-C)
CONFIG_ESP_CONSOLE_USB_SERIAL_JTAG=y
# Web GUI to view/configure the Thread network (selects Commissioner + Joiner)
CONFIG_OPENTHREAD_BR_START_WEB=y
# Auto-connect Wi-Fi and form Thread network on boot
CONFIG_OPENTHREAD_BR_AUTO_START=y
# SoftAP fallback provisioning (http://192.168.4.1) when no Wi-Fi credentials
CONFIG_OPENTHREAD_BR_SOFTAP_SETUP=y
# end of ESP Thread Border Router board / RCP wiring

#
# Wi-Fi uplink credentials
#
CONFIG_EXAMPLE_WIFI_SSID="7.4"
CONFIG_EXAMPLE_WIFI_PASSWORD="ww666666"
# end of Wi-Fi uplink credentials

#
# Ethernet
# 
CONFIG_EXAMPLE_USE_W5500=y
CONFIG_EXAMPLE_ETH_SPI_HOST=2
CONFIG_EXAMPLE_ETH_SPI_SCLK_GPIO=21
CONFIG_EXAMPLE_ETH_SPI_MOSI_GPIO=45
CONFIG_EXAMPLE_ETH_SPI_MISO_GPIO=38
CONFIG_EXAMPLE_ETH_SPI_CS_GPIO=41
CONFIG_EXAMPLE_ETH_SPI_CLOCK_MHZ=36
CONFIG_EXAMPLE_ETH_SPI_INT_GPIO=39
CONFIG_EXAMPLE_ETH_PHY_RST_GPIO=40
CONFIG_EXAMPLE_ETH_PHY_ADDR=1
# end of Ethernet

#
# http server
#
CONFIG_HTTPD_MAX_REQ_HDR_LEN=1024
```

## examples/common/iot_device_core/Kconfig.projbuild
```kconfig
menu "IoT Device Core"

    config IOT_CORE_SERVICE_NAME
        string "SRP service name"
        default "_iot._udp"

    config IOT_CORE_CTRL_URI
        string "CoAP control resource path"
        default "ctrl"

    config IOT_CORE_ACK_URI
        string "BR uplink resource path"
        default "ack"

    config IOT_CORE_MULTICAST_ADDR
        string "Multicast group to join"
        default "ff03::1"

    config IOT_CORE_COAP_PORT
        int "CoAP port"
        default 5683

    config IOT_CORE_WORKER_STACK
        int "Command worker task stack size (bytes)"
        default 4096

    config IOT_CORE_WORKER_QUEUE_LEN
        int "Command worker queue length"
        default 8

endmenu
```

## examples/common/mqtt_ot_bridge/Kconfig.projbuild
```kconfig
menu "MQTT OT Bridge"

    config MQTT_OT_BRIDGE_ENABLE
        bool "Enable MQTT to OpenThread CoAP bridge"
        default n
        help
            启用后，BR 连接局域网 MQTT broker，把下行命令翻译为 CoAP 请求，
            并把设备响应与 SRP 设备清单发布回 MQTT。

    if MQTT_OT_BRIDGE_ENABLE

        config MQTT_OT_BRIDGE_BROKER_URI
            string "MQTT broker URI"
            default "mqtt://192.168.1.100:1883"
            help
                broker 地址。mqtt://host:port 为明文；mqtts://host:port 启用 TLS,
                此时用组件内嵌入的 CA 证书(certs/mqtt_ca_cert.pem)校验服务器证书。

        config MQTT_OT_BRIDGE_USERNAME
            string "MQTT username"
            default "bridge"

        config MQTT_OT_BRIDGE_PASSWORD
            string "MQTT password"
            default "changeme"

        config MQTT_OT_BRIDGE_TOPIC_PREFIX
            string "MQTT topic prefix"
            default "otbr"
            help
                所有 topic 的前缀，如 otbr/cmd/unicast/<eui64>。

        config MQTT_OT_BRIDGE_MULTICAST_ADDR
            string "CoAP multicast address"
            default "ff03::1"

        config MQTT_OT_BRIDGE_COAP_URI
            string "CoAP downlink resource path on devices"
            default "ctrl"
            help
                下行命令发往设备的 CoAP Uri-Path(不含前导斜杠)。

        config MQTT_OT_BRIDGE_ACK_URI
            string "CoAP uplink resource path on BR"
            default "ack"
            help
                BR 侧接收设备主动上报的 CoAP 资源 Uri-Path。

        config MQTT_OT_BRIDGE_COAP_PORT
            int "CoAP port"
            default 5683

        config MQTT_OT_BRIDGE_REGISTRY_INTERVAL_S
            int "Device registry publish interval (seconds)"
            default 30
            range 5 3600

    endif

endmenu
```

## examples/deep_sleep/main/Kconfig.projbuild
```kconfig
menu "Deep Sleep Motion Sensor"

    config MOTION_WAKEUP_GPIO
        int "Motion sensor wakeup GPIO"
        default 8
        help
            运动传感器 3.3V 输出接入的 GPIO。EXT1 深睡唤醒仅支持 RTC GPIO,
            ESP32-H2 合法范围为 8-14(GPIO7 虽是 RTC 但未引出,GPIO9 为 BOOT)。
            唤醒条件为高电平(检测到运动=3.3V)。

    config MOTION_HEARTBEAT_SEC
        int "Heartbeat wakeup interval (seconds)"
        default 300
        help
            RTC 定时器唤醒间隔,作为周期性"存活"心跳上报。

    config MOTION_MAX_AWAKE_MS
        int "Max awake fallback (ms)"
        default 10000
        help
            唤醒后最大清醒兜底毫秒数。无论上报是否成功,到点强制回深睡,
            防止 attach/上报失败时无限清醒耗电。

    config MOTION_SRP_SERVICE_NAME
        string "SRP service name"
        default "_iot._udp"
        help
            通过 SRP 注册的服务类型名,须与 BR mqtt_ot_bridge 约定一致。

    config MOTION_ACK_URI
        string "BR uplink CoAP resource path"
        default "devup"
        help
            上报目标:BR 的 CoAP 资源,设为 devup 以发布到 MQTT dev/up 主题。

    config MOTION_COAP_PORT
        int "CoAP port"
        default 5683
        help
            CoAP 端口,须与 BR mqtt_ot_bridge 一致。

endmenu
```

## examples/ot_iot_device/main/Kconfig.projbuild
```kconfig
menu "IoT Device Example"

    config IOT_DEVICE_SWITCH_GPIO
        int "Switch/LED GPIO number"
        default 8
        help
            控制开关状态的 GPIO(接 LED 或继电器)。ESP32-H2 devkit 板载 LED 可用 8。

    config IOT_DEVICE_SERVICE_NAME
        string "SRP service name"
        default "_iot._udp"
        help
            设备通过 SRP 注册的服务类型名。

    config IOT_DEVICE_CTRL_URI
        string "CoAP control resource path"
        default "ctrl"
        help
            接收控制命令的 CoAP Uri-Path，必须与 BR 的 MQTT_OT_BRIDGE_COAP_URI 一致。

    config IOT_DEVICE_ACK_URI
        string "BR uplink resource path"
        default "ack"
        help
            上报目标：BR 的 CoAP 资源，必须与 BR 的 MQTT_OT_BRIDGE_ACK_URI 一致。

    config IOT_DEVICE_MULTICAST_ADDR
        string "Multicast group to join"
        default "ff03::1"
        help
            加入的组播组，必须与 BR 的 MQTT_OT_BRIDGE_MULTICAST_ADDR 一致。

    config IOT_DEVICE_COAP_PORT
        int "CoAP port"
        default 5683

endmenu
```
